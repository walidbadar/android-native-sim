## boards/native/native_sim_aarch64/Kconfig
```kconfig
# Copyright (c) 2026 Muhammad Waleed Badar
# SPDX-License-Identifier: GPL-3.0-only

config BOARD_NATIVE_SIM
	select 64BIT if BOARD_NATIVE_SIM_NATIVE_AARCH64

config ANDROID_PHONE_IP
	string "IP address of the Android phone"
	depends on BOARD_NATIVE_SIM_NATIVE_AARCH64
	help
	  Where "west build -t run" finds the phone. When it is empty, adb uses the
	  phone it already sees, and an application with a screen asks adb for the
	  address to reach Termux over SSH. When it is set, adb connects to it.
```

## boards/native/native_sim_aarch64/board.yml
```yaml
board:
  extend: native_sim
  variants:
    - name: aarch64
      qualifier: native
```

## drivers/gnss/Kconfig
```kconfig
# SPDX-FileCopyrightText: 2026 Muhammad Waleed Badar
# SPDX-License-Identifier: Apache-2.0

config GNSS_NATIVE_SIM
	bool "native_sim GNSS receiver"
	default y
	depends on DT_HAS_ZEPHYR_NATIVE_SIM_GNSS_ENABLED
	depends on ARCH_POSIX
	select NATIVE_SIMULATOR_PREFER_REAL_TIME
	help
	  GNSS receiver for native_sim that reports a position taken from the
	  host: an Android phone's location, read with dumpsys directly or
	  through adb, or a fixed position given on the command line.

if GNSS_NATIVE_SIM

config GNSS_NATIVE_SIM_FIX_INTERVAL_MS
	int "Fix interval at power on (ms)"
	default 1000
	range 100 60000
	help
	  How often a fix is published until the application sets the fix
	  rate through the GNSS API.

config GNSS_NATIVE_SIM_POLL_PERIOD_MS
	int "Host location poll period (ms)"
	default 1000
	range 100 60000
	help
	  Real time between reads of the host location. dumpsys takes a
	  noticeable time, through adb even more, so this is not the fix
	  interval: each fix publishes the newest position read.

config GNSS_NATIVE_SIM_MAX_FIX_AGE_MS
	int "Oldest host fix reported (ms)"
	default 10000
	range 0 3600000
	help
	  A host fix older than this is reported as no fix. Android only
	  updates its location while some app requests it, so this is what
	  tells a live position from a stale one. 0 reports a fix of any age.

endif # GNSS_NATIVE_SIM
```

## dts/bindings/gnss/zephyr,native-sim-gnss.yaml
```yaml
# SPDX-FileCopyrightText: 2026 Muhammad Waleed Badar
# SPDX-License-Identifier: Apache-2.0

title: native_sim GNSS receiver

description: |
  GNSS receiver for native_sim, fed by a location source on the host.

  By default the location of an Android phone is read with "dumpsys location":
  directly when the executable runs on the phone as the adb shell user, and
  through adb otherwise (ANDROID_SERIAL selects the device when several are
  connected). The --<node name>_position=<lat>,<lon>[,<alt>] command line
  option reports that fixed position instead, without a phone.

  The fix rate set through the GNSS API only changes how often the newest
  position is published; the host is read every
  CONFIG_GNSS_NATIVE_SIM_POLL_PERIOD_MS. A host fix older than
  CONFIG_GNSS_NATIVE_SIM_MAX_FIX_AGE_MS is reported as no fix. Every start mode
  is accepted and makes no difference. Android does not say which satellites a
  fix used, so none are reported, and the HDOP is derived from the horizontal
  accuracy.

compatible: "zephyr,native-sim-gnss"

include: base.yaml

examples:
  - |
      / {
          aliases {
              gnss = &gnss_host;
          };

          gnss_host: gnss_host {
              compatible = "zephyr,native-sim-gnss";
          };
      };
```

## tests/drivers/gnss/native_sim/testcase.yaml
```yaml
# Copyright (c) 2026 Muhammad Waleed Badar
# SPDX-License-Identifier: Apache-2.0

tests:
  drivers.gnss.native_sim:
    tags:
      - drivers
      - gnss
    platform_allow:
      - native_sim/native/64
    integration_platforms:
      - native_sim/native/64
```
